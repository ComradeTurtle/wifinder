## main/Kconfig.projbuild
```kconfig
menu "WIFINDER"

config WG_RGB_LED_ENABLE
    bool "Enable RGB status LED"
    default y
    help
        Enables a single WS2812-style RGB LED used for runtime status.

if WG_RGB_LED_ENABLE

config WG_RGB_LED_GPIO
    int "RGB LED data GPIO"
    range 0 48
    default 48
    help
        GPIO connected to the RGB LED data input.

config WG_RGB_LED_FRAME_MS
    int "RGB LED refresh interval (ms)"
    range 10 250
    default 40
    help
        LED task period. Lower values smooth animations at a higher CPU cost.

config WG_RGB_LED_BT_PULSE_MS
    int "Bluetooth activity pulse length (ms)"
    range 40 1000
    default 140
    help
        How long RX/TX activity pulses remain visible on the LED.

config WG_RGB_LED_BRIGHTNESS_PCT
    int "RGB LED brightness (%)"
    range 1 100
    default 8
    help
        Global brightness scaling for all status colors and pulses.

endif

endmenu
```

## sdkconfig.defaults
```kconfig
CONFIG_ESPTOOLPY_FLASHSIZE_16MB=y
CONFIG_ESPTOOLPY_FLASHSIZE="16MB"
CONFIG_ESP_MAIN_TASK_STACK_SIZE=8192
CONFIG_BT_ENABLED=y
CONFIG_BT_BLE_ENABLED=y
CONFIG_BT_NIMBLE_ENABLED=y
CONFIG_BT_NIMBLE_ROLE_PERIPHERAL=y
CONFIG_BT_NIMBLE_NVS_PERSIST=y
CONFIG_BT_NIMBLE_ATT_PREFERRED_MTU=517
CONFIG_BT_NIMBLE_MSYS_1_BLOCK_COUNT=48
CONFIG_BT_NIMBLE_MSYS_2_BLOCK_COUNT=48
CONFIG_BT_NIMBLE_MSYS_2_BLOCK_SIZE=600
CONFIG_BT_NIMBLE_TRANSPORT_ACL_FROM_LL_COUNT=48
CONFIG_BT_LE_CONN_RESERVED_MEMORY_COUNT=1
CONFIG_BT_NIMBLE_MAX_CONNECTIONS=1
CONFIG_ESP_CONSOLE_UART_DEFAULT=y
CONFIG_ESP_CONSOLE_SECONDARY_USB_SERIAL_JTAG=y
CONFIG_WG_RGB_LED_ENABLE=y
CONFIG_WG_RGB_LED_GPIO=48
CONFIG_WG_RGB_LED_FRAME_MS=40
CONFIG_WG_RGB_LED_BT_PULSE_MS=140
CONFIG_WG_RGB_LED_BRIGHTNESS_PCT=8
```

## sdkconfig.defaults.esp32c6
```kconfig
CONFIG_ESPTOOLPY_FLASHSIZE_8MB=y
CONFIG_ESPTOOLPY_FLASHSIZE="8MB"
CONFIG_PARTITION_TABLE_CUSTOM=y
CONFIG_PARTITION_TABLE_CUSTOM_FILENAME="partitions_c6.csv"
CONFIG_WG_RGB_LED_GPIO=8
```
